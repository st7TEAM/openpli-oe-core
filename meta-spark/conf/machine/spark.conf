## meta-spark/conf/machine/spark.conf
```bitbake
require conf/machine/include/spark.inc

MACHINE_NAME = "spark"
MACHINE_OEM = "spark"
CHIPSET = "sti7111"

MACHINE_KERNEL_PR = "r1"

EXTRA_IMAGEDEPENDS += "\
        enigma2-plugin-systemplugins-vfdcontrol \
        "

MACHINE_EXTRA_RDEPENDS += "\
        enigma2-plugin-systemplugins-vfdcontrol \
        "

MACHINE_ESSENTIAL_EXTRA_RDEPENDS += " \
	stlinux24-sh4-stmfb-firmware-stx7111 \
"

module_conf_stmfb = "options stmfb display0=1280x720-32@50:12m:pal:yuv:yuv"
module_conf_embxmailbox = "options embxmailbox mailbox0=0xfe211000:136:set2 mailbox1=0xfe212000:0"
module_conf_embxshm = "options embxshm mailbox0=shm:0:7:0x60000000:0:256:256:0:512:0x40000000:0x10000000"
module_conf_mme_host = "options mme_host transport0=shm"
module_conf_avs = "options avs type=avs_pio"
module_conf_pti = "options pti waitMS=20 videoMem=4096"
module_conf_player2 = "options player2 discardlateframe=0"
module_conf_cec = "options cec activemode=1"
```
